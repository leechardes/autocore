## firmware/esp32-relay-esp-idf/main/Kconfig.projbuild
```kconfig
# ESP32 Relay Project Configuration

menu "ESP32 Relay Configuration"

    config ESP32_RELAY_MAX_CHANNELS
        int "Maximum number of relay channels"
        range 1 16
        default 16
        help
            Maximum number of relay channels supported by the device

    config ESP32_RELAY_DEFAULT_AP_SSID_PREFIX
        string "Default AP SSID prefix"
        default "ESP32-Relay"
        help
            Prefix for the Access Point SSID when in AP mode

    config ESP32_RELAY_DEFAULT_AP_PASSWORD
        string "Default AP password"
        default "12345678"
        help
            Default password for the Access Point

    config ESP32_RELAY_DEFAULT_BACKEND_IP
        string "Default backend IP address"
        default "10.0.10.100"
        help
            Default IP address of the AutoCore backend

    config ESP32_RELAY_DEFAULT_BACKEND_PORT
        int "Default backend port"
        range 1 65535
        default 8081
        help
            Default port of the AutoCore backend

    config ESP32_RELAY_DEFAULT_MQTT_PORT
        int "Default MQTT port"
        range 1 65535
        default 1883
        help
            Default MQTT broker port

    config ESP32_RELAY_TELEMETRY_INTERVAL
        int "Telemetry publishing interval (seconds)"
        range 5 300
        default 30
        help
            Interval in seconds for publishing telemetry data

    config ESP32_RELAY_WIFI_TIMEOUT
        int "WiFi connection timeout (seconds)"
        range 5 60
        default 15
        help
            Timeout in seconds for WiFi connection attempts

    config ESP32_RELAY_MQTT_RETRY_COUNT
        int "MQTT connection retry count"
        range 1 10
        default 5
        help
            Number of MQTT connection retry attempts

endmenu
```

## firmware/esp32-relay-esp-idf/sdkconfig.defaults
```kconfig
# ESP32 Relay ESP-IDF Configuration Defaults
# Optimized for high performance and low memory usage

# System configuration
CONFIG_ESP_MAIN_TASK_STACK_SIZE=8192
CONFIG_ESP_SYSTEM_EVENT_TASK_STACK_SIZE=4096
CONFIG_ESP_TIMER_TASK_STACK_SIZE=4096
CONFIG_ESP_TASK_WDT_TIMEOUT_S=10

# Flash configuration
CONFIG_ESPTOOLPY_FLASHSIZE_4MB=y
CONFIG_ESPTOOLPY_FLASHSIZE="4MB"
CONFIG_ESPTOOLPY_FLASHFREQ_40M=y

# WiFi configuration
CONFIG_ESP32_WIFI_ENABLE_WPA3_SAE=y
CONFIG_ESP32_WIFI_SW_COEXIST_ENABLE=y
CONFIG_ESP32_WIFI_STATIC_RX_BUFFER_NUM=4
CONFIG_ESP32_WIFI_DYNAMIC_RX_BUFFER_NUM=8
CONFIG_ESP32_WIFI_DYNAMIC_TX_BUFFER_NUM=16

# HTTP Server configuration  
CONFIG_HTTPD_MAX_REQ_HDR_LEN=2048
CONFIG_HTTPD_MAX_URI_LEN=512
CONFIG_HTTP_SERVER_STACK_SIZE=8192

# MQTT configuration
CONFIG_MQTT_PROTOCOL_311=y
CONFIG_MQTT_TRANSPORT_SSL=y
CONFIG_MQTT_TRANSPORT_WEBSOCKET=y

# Memory optimization
CONFIG_SPIRAM_SUPPORT=n
CONFIG_ESP32_DEFAULT_CPU_FREQ_MHZ_240=y

# NVS Storage
CONFIG_NVS_ENCRYPTION=n

# Logging levels (optimized for production)
CONFIG_LOG_DEFAULT_LEVEL_INFO=y
CONFIG_LOG_MAXIMUM_EQUALS_DEFAULT=y

# Compiler optimizations
CONFIG_COMPILER_OPTIMIZATION_SIZE=y
CONFIG_COMPILER_OPTIMIZATION_ASSERTIONS_SILENT=y

# FreeRTOS
CONFIG_FREERTOS_HZ=1000
CONFIG_FREERTOS_USE_TRACE_FACILITY=n
CONFIG_FREERTOS_USE_STATS_FORMATTING_FUNCTIONS=n

# Network
CONFIG_LWIP_MAX_SOCKETS=10
CONFIG_LWIP_SO_REUSE=y
CONFIG_LWIP_SO_RCVBUF=y
CONFIG_LWIP_TCPIP_TASK_STACK_SIZE=4096

# Partition table
CONFIG_PARTITION_TABLE_CUSTOM=y
CONFIG_PARTITION_TABLE_CUSTOM_FILENAME="partitions.csv"

# Application specific
CONFIG_ESP32_RELAY_MAX_CHANNELS=16
CONFIG_ESP32_RELAY_DEFAULT_BACKEND_IP="10.0.10.100"
CONFIG_ESP32_RELAY_DEFAULT_BACKEND_PORT=8081
CONFIG_ESP32_RELAY_DEFAULT_MQTT_PORT=1883
```
