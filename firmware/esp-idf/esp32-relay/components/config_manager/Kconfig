## firmware/esp-idf/esp32-relay/components/config_manager/Kconfig
```kconfig
menu "Configuration Manager"

    config CONFIG_MANAGER_DEFAULT_DEVICE_NAME
        string "Default device name prefix"
        default "ESP32-Relay"
        help
            Default prefix for device name generation.

    config CONFIG_MANAGER_MAX_WIFI_SSID_LEN
        int "Maximum WiFi SSID length"
        default 32
        range 1 32
        help
            Maximum length for WiFi SSID string.

    config CONFIG_MANAGER_MAX_WIFI_PASSWORD_LEN
        int "Maximum WiFi password length"
        default 64
        range 1 64
        help
            Maximum length for WiFi password string.

    config CONFIG_MANAGER_MAX_MQTT_BROKER_LEN
        int "Maximum MQTT broker address length"
        default 64
        range 1 128
        help
            Maximum length for MQTT broker address string.

    config CONFIG_MANAGER_AUTO_SAVE_INTERVAL
        int "Auto-save configuration interval (seconds)"
        default 300
        range 30 3600
        help
            Interval in seconds for automatic configuration saving to NVS.
            Set to 0 to disable auto-save.

endmenu
```

## firmware/esp-idf/esp32-relay/components/relay_control/Kconfig
```kconfig
menu "Relay Control Configuration"

    config RELAY_MAX_CHANNELS
        int "Maximum number of relay channels"
        default 8
        range 1 16
        help
            Set the maximum number of relay channels supported by the hardware.

    config RELAY_DEFAULT_STATE
        bool "Default relay state on boot"
        default n
        help
            Set the default state of relays when the device boots.
            - Disabled (n): All relays OFF on boot
            - Enabled (y): All relays ON on boot
            
    config RELAY_INVERT_LOGIC
        bool "Invert relay logic"
        default n
        help
            If enabled, relay logic is inverted:
            - HIGH = OFF (relay not energized)
            - LOW = ON (relay energized)

    config RELAY_ENABLE_PROTECTION
        bool "Enable relay protection features"
        default y
        help
            Enable advanced relay protection features like:
            - Switch counting
            - Temperature monitoring
            - Overload detection

    config RELAY_SWITCH_COUNT_PERSISTENCE
        bool "Save switch counts to NVS"
        default y
        depends on RELAY_ENABLE_PROTECTION
        help
            Save relay switch counts to NVS for persistence across reboots.

    config RELAY_MAX_SWITCHES_PER_HOUR
        int "Maximum switches per hour (protection)"
        default 100
        range 10 1000
        depends on RELAY_ENABLE_PROTECTION
        help
            Maximum number of relay switches allowed per hour before protection kicks in.

    config RELAY_DEBOUNCE_TIME_MS
        int "Relay debounce time (ms)"
        default 50
        range 10 500
        help
            Debounce time for relay switching to prevent contact bounce issues.

    config RELAY_GPIO_PINS
        string "Relay GPIO pin mapping"
        default "{2,4,16,17,5,18,19,21}"
        help
            GPIO pin mapping for relay channels in array format.
            Example: {2,4,16,17,5,18,19,21} for 8 channels.

endmenu
```

## firmware/esp-idf/esp32-relay/components/web_interface/Kconfig
```kconfig
menu "Web Interface Configuration"

    config WEB_INTERFACE_ENABLE
        bool "Enable web interface component"
        default n
        help
            Enable the web interface component for future implementation.
            Currently acts as placeholder for modular architecture.

    config WEB_INTERFACE_COMPRESSION
        bool "Enable web asset compression"
        default y
        depends on WEB_INTERFACE_ENABLE
        help
            Enable compression for web assets (HTML, CSS, JS) to save flash space.

    config WEB_INTERFACE_MAX_ASSETS
        int "Maximum number of web assets"
        default 10
        range 5 50
        depends on WEB_INTERFACE_ENABLE
        help
            Maximum number of web assets that can be embedded.

endmenu
```

## firmware/esp32-display-esp-idf/main/Kconfig.projbuild
```kconfig
menu "ESP32 Display Configuration"

    config ESP32_DISPLAY_PROJECT_NAME
        string "Project Name"
        default "ESP32-Display"
        help
            Project name for display device

    config ESP32_DISPLAY_DEFAULT_AP_PASSWORD
        string "Default AP Password"
        default "autocore123"
        help
            Default password for AP mode

    config ESP32_DISPLAY_MDNS_ENABLED
        bool "Enable mDNS"
        default y
        help
            Enable mDNS for device discovery

    config ESP32_DISPLAY_OTA_ENABLED
        bool "Enable OTA Updates"
        default y
        help
            Enable Over-The-Air updates

    menu "Display Hardware Configuration"

        choice ESP32_DISPLAY_TYPE
            prompt "Display Type"
            default ESP32_DISPLAY_ILI9341
            help
                Select the display controller type

            config ESP32_DISPLAY_ILI9341
                bool "ILI9341 (320x240)"
            
            config ESP32_DISPLAY_ST7789
                bool "ST7789 (240x240 or 240x320)"
            
            config ESP32_DISPLAY_SSD1306
                bool "SSD1306 OLED (128x64)"
            
            config ESP32_DISPLAY_ILI9488
                bool "ILI9488 (480x320)"
        endchoice

        config ESP32_DISPLAY_WIDTH
            int "Display Width"
            default 240 if ESP32_DISPLAY_ILI9341
            default 240 if ESP32_DISPLAY_ST7789
            default 128 if ESP32_DISPLAY_SSD1306
            default 480 if ESP32_DISPLAY_ILI9488
            help
                Display width in pixels (native resolution)

        config ESP32_DISPLAY_HEIGHT
            int "Display Height"
            default 320 if ESP32_DISPLAY_ILI9341
            default 240 if ESP32_DISPLAY_ST7789
            default 64 if ESP32_DISPLAY_SSD1306
            default 320 if ESP32_DISPLAY_ILI9488
            help
                Display height in pixels (native resolution)

        config ESP32_DISPLAY_MISO_GPIO
            int "MISO GPIO number"
            default 12
            help
                GPIO number for SPI MISO signal

        config ESP32_DISPLAY_MOSI_GPIO
            int "MOSI GPIO number"
            default 13
            help
                GPIO number for SPI MOSI signal

        config ESP32_DISPLAY_SCLK_GPIO
            int "SCLK GPIO number"
            default 14
            help
                GPIO number for SPI SCLK signal

        config ESP32_DISPLAY_CS_GPIO
            int "CS GPIO number"
            default 15
            help
                GPIO number for SPI CS signal

        config ESP32_DISPLAY_DC_GPIO
            int "DC GPIO number"
            default 2
            help
                GPIO number for Data/Command signal

        config ESP32_DISPLAY_RST_GPIO
            int "RESET GPIO number"
            default 12
            help
                GPIO number for RESET signal (can share with MISO)

        config ESP32_DISPLAY_BL_GPIO
            int "Backlight GPIO number"
            default 21
            help
                GPIO number for backlight control
        
        config ESP32_DISPLAY_SPI_FREQ
            int "SPI Frequency (Hz)"
            default 65000000
            range 10000000 80000000
            help
                SPI clock frequency for display (65MHz recommended for ILI9341)

        config ESP32_DISPLAY_TOUCH_ENABLED
            bool "Enable Touch Controller"
            default y
            help
                Enable touch controller support (XPT2046)

        if ESP32_DISPLAY_TOUCH_ENABLED
            config ESP32_DISPLAY_TOUCH_CS_GPIO
                int "Touch CS GPIO number"
                default 33
                help
                    GPIO number for touch controller CS
            
            config ESP32_DISPLAY_TOUCH_IRQ_GPIO
                int "Touch IRQ GPIO number"
                default 36
                help
                    GPIO number for touch interrupt
            
            config ESP32_DISPLAY_TOUCH_MOSI_GPIO
                int "Touch MOSI GPIO number"
                default 32
                help
                    GPIO number for touch SPI MOSI (VSPI)
            
            config ESP32_DISPLAY_TOUCH_MISO_GPIO
                int "Touch MISO GPIO number"
                default 39
                help
                    GPIO number for touch SPI MISO (VSPI)
            
            config ESP32_DISPLAY_TOUCH_CLK_GPIO
                int "Touch CLK GPIO number"
                default 25
                help
                    GPIO number for touch SPI clock (VSPI)
            
            config ESP32_DISPLAY_TOUCH_SPI_FREQ
                int "Touch SPI Frequency (Hz)"
                default 2500000
                range 1000000 5000000
                help
                    SPI clock frequency for touch controller
        endif

    endmenu

    menu "Display Features"

        config ESP32_DISPLAY_ROTATION
            int "Display Rotation"
            range 0 3
            default 1
            help
                Display rotation (0=0°, 1=90°, 2=180°, 3=270°)

        config ESP32_DISPLAY_BUFFER_SIZE
            int "Display Buffer Size (lines)"
            range 10 240
            default 40
            help
                Number of display lines for partial buffer

        config ESP32_DISPLAY_FPS_COUNTER
            bool "Show FPS Counter"
            default n
            help
                Show frames per second counter

        config ESP32_DISPLAY_AUTO_BRIGHTNESS
            bool "Auto Brightness"
            default y
            help
                Enable automatic brightness adjustment

    endmenu

endmenu
```

## firmware/esp32-display-esp-idf/sdkconfig.defaults
```kconfig
# ESP32 Display Default Configuration
# Optimized for performance and display operations

# ESP32 specific
CONFIG_IDF_TARGET="esp32"
CONFIG_IDF_TARGET_ESP32=y

# CPU Configuration
CONFIG_ESP32_DEFAULT_CPU_FREQ_240=y
CONFIG_ESP32_DEFAULT_CPU_FREQ_MHZ=240

# Memory Configuration
# ESP32-2432S028R doesn't have PSRAM
CONFIG_ESP32_SPIRAM_SUPPORT=n
CONFIG_SPIRAM=n

# Flash Configuration
CONFIG_ESPTOOLPY_FLASHMODE_QIO=y
CONFIG_ESPTOOLPY_FLASHFREQ_80M=y
CONFIG_ESPTOOLPY_FLASHSIZE_4MB=y
CONFIG_PARTITION_TABLE_CUSTOM=y
CONFIG_PARTITION_TABLE_CUSTOM_FILENAME="partitions.csv"

# WiFi Configuration
CONFIG_ESP32_WIFI_STATIC_RX_BUFFER_NUM=16
CONFIG_ESP32_WIFI_DYNAMIC_RX_BUFFER_NUM=32
CONFIG_ESP32_WIFI_DYNAMIC_TX_BUFFER_NUM=32
CONFIG_ESP32_WIFI_AMPDU_TX_ENABLED=y
CONFIG_ESP32_WIFI_TX_BA_WIN=6
CONFIG_ESP32_WIFI_AMPDU_RX_ENABLED=y
CONFIG_ESP32_WIFI_RX_BA_WIN=6

# LWIP Configuration
CONFIG_LWIP_LOCAL_HOSTNAME="esp32-display"
CONFIG_LWIP_NETIF_STATUS_CALLBACK=y
CONFIG_LWIP_NETIF_LINK_CALLBACK=y

# HTTP Server Configuration
CONFIG_HTTPD_MAX_REQ_HDR_LEN=1024
CONFIG_HTTPD_MAX_URI_LEN=512
CONFIG_HTTPD_WS_SUPPORT=y

# MQTT Configuration
CONFIG_MQTT_PROTOCOL_5=y
CONFIG_MQTT_TRANSPORT_SSL=y
CONFIG_MQTT_TRANSPORT_WEBSOCKET=y
CONFIG_MQTT_USE_CUSTOM_CONFIG=y
CONFIG_MQTT_BUFFER_SIZE=1024
CONFIG_MQTT_TASK_STACK_SIZE=6144

# FreeRTOS Configuration
CONFIG_FREERTOS_HZ=1000
CONFIG_FREERTOS_TIMER_TASK_STACK_DEPTH=3072
CONFIG_FREERTOS_GENERATE_RUN_TIME_STATS=y

# Log Configuration
CONFIG_LOG_DEFAULT_LEVEL_INFO=y
CONFIG_LOG_MAXIMUM_LEVEL_VERBOSE=y
CONFIG_LOG_COLORS=y
CONFIG_LOG_TIMESTAMP_SOURCE_RTOS=y

# SPI Configuration for Display
CONFIG_SPI_MASTER_ISR_IN_IRAM=y
CONFIG_SPI_MASTER_IN_IRAM=y

# GPIO Configuration
CONFIG_GPIO_CTRL_FUNC_IN_IRAM=y

# Display Driver Specific - Based on HMI Display v2
CONFIG_LV_COLOR_DEPTH_16=y
CONFIG_LV_COLOR_16_SWAP=n
CONFIG_LV_MEM_CUSTOM=n
CONFIG_LV_MEM_SIZE_KILOBYTES=64
CONFIG_LV_TICK_CUSTOM=y
CONFIG_LV_TICK_CUSTOM_INCLUDE="esp_timer.h"
CONFIG_LV_TICK_CUSTOM_SYS_TIME_EXPR="(esp_timer_get_time()/1000)"
CONFIG_LV_DPI=100
CONFIG_LV_DISP_DEF_REFR_PERIOD=30
CONFIG_LV_INDEV_DEF_READ_PERIOD=30

# Project Specific
CONFIG_ESP32_DISPLAY_PROJECT_NAME="ESP32-Display"
CONFIG_ESP32_DISPLAY_DEFAULT_AP_PASSWORD="autocore123"
CONFIG_ESP32_DISPLAY_MDNS_ENABLED=y
CONFIG_ESP32_DISPLAY_OTA_ENABLED=y
```

## firmware/esp32-relay-esp-idf/components/network/Kconfig
```kconfig
menu "Network Component"

    menu "WiFi Manager"
        
        config WIFI_MANAGER_MAX_RETRY
            int "WiFi connection maximum retry attempts"
            default 10
            range 1 50
            help
                Maximum number of retry attempts for WiFi connection.

        config WIFI_MANAGER_RETRY_DELAY_MS
            int "WiFi connection retry delay (ms)"
            default 5000
            range 1000 30000
            help
                Delay between WiFi connection retry attempts in milliseconds.

        config WIFI_MANAGER_AP_TIMEOUT_MS
            int "AP mode timeout (ms)"
            default 300000
            range 60000 1800000
            help
                Timeout for AP mode before switching back to STA mode.

    endmenu

    menu "HTTP Server"

        config HTTP_SERVER_PORT
            int "HTTP server port"
            default 80
            range 1 65535
            help
                Port number for the HTTP server.

        config HTTP_SERVER_MAX_HANDLERS
            int "Maximum HTTP handlers"
            default 20
            range 5 50
            help
                Maximum number of HTTP request handlers.

        config HTTP_SERVER_STACK_SIZE
            int "HTTP server task stack size"
            default 4096
            range 2048 8192
            help
                Stack size for HTTP server task in bytes.

    endmenu

    menu "MQTT Handler"

        config MQTT_KEEPALIVE_INTERVAL
            int "MQTT keepalive interval (seconds)"
            default 60
            range 10 300
            help
                MQTT keepalive interval in seconds.

        config MQTT_MAX_RETRIES
            int "MQTT connection maximum retries"
            default 5
            range 1 20
            help
                Maximum number of MQTT connection retry attempts.

        config MQTT_RETRY_DELAY_MS
            int "MQTT retry delay (ms)"
            default 5000
            range 1000 30000
            help
                Delay between MQTT connection retry attempts.

        config MQTT_TELEMETRY_INTERVAL_MS
            int "Telemetry publish interval (ms)"
            default 10000
            range 1000 60000
            help
                Interval for publishing telemetry data via MQTT.

    endmenu

endmenu
```
